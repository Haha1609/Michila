#include "dactyl.dtsi"

&default_transform { 
    col-offset = <7>;
};

&kscan0 {
    col-gpios
            =<&gpio0 17 GPIO_ACTIVE_HIGH>,
			 <&gpio0 20 GPIO_ACTIVE_HIGH>,
             <&gpio0 22 GPIO_ACTIVE_HIGH>, 
             <&gpio0 24 GPIO_ACTIVE_HIGH>, 
             <&gpio1 0 GPIO_ACTIVE_HIGH>,
             <&gpio0 11 GPIO_ACTIVE_HIGH>,  
             <&gpio1 4 GPIO_ACTIVE_HIGH> 
           ;  
};

&encoder_right {
    status = "okay";
};



