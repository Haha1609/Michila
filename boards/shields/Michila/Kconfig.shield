## boards/shields/Michila/Kconfig.shield
```kconfig
# No whitespace after the comma or in your part name!
config SHIELD_MICHILA_LEFT
    def_bool $(shields_list_contains,MICHILA_left)

# No whitespace after the comma or in your part name!
config SHIELD_MICHILA_RIGHT
    def_bool $(shields_list_contains,MICHILA_right)

CONFIG_ZMK_SOFT_OFF=y
```
