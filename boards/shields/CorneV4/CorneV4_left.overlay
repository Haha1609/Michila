#include "CorneV4.dtsi"


&kscan0 {
    col-gpios
          =  <&gpio0 2 GPIO_ACTIVE_HIGH>,
             <&gpio1 15 GPIO_ACTIVE_HIGH>,
             <&gpio1 13 GPIO_ACTIVE_HIGH>,
             <&gpio0 20  GPIO_ACTIVE_HIGH>,  //broken mcu
             <&gpio0 10 GPIO_ACTIVE_HIGH>,
             <&gpio0 9  GPIO_ACTIVE_HIGH>
            ;
};

&encoder_left {
    status = "okay";
};


