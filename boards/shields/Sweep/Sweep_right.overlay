#include "Sweep.dtsi"

&default_transform { 
    col-offset = <5>;   //right side will start from the offset+1=6th col//
};

&kscan0 {
    col-gpios
            =<&gpio0 31 GPIO_ACTIVE_HIGH>,
			 <&gpio0 29 GPIO_ACTIVE_HIGH>,
             <&gpio0 2 GPIO_ACTIVE_HIGH>, 
             <&gpio1 15 GPIO_ACTIVE_HIGH>, 
             <&gpio1 13 GPIO_ACTIVE_HIGH> 
           ;  

};

//&encoder_right {
//    status = "okay";
//};


